## orangepi-3/package/qt5_test_app/Config.in
```kconfig
config BR2_PACKAGE_QT5_TEST_APP
        bool "qt5_test_app"
        help
          This is a simple game on SDL framework.

          http://intemslab.ru/sdl-game-0.01.tar.gz
```

## orangepi-3/package/sdl_game/Config.in
```kconfig
config BR2_PACKAGE_SDL_GAME
        bool "sdl-game"
        help
          This is a simple game on SDL framework.

          http://intemslab.ru/sdl-game-0.01.tar.gz
```
